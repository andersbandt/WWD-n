## build/WWD-n/Kconfig/boards/Kconfig
```kconfig
# Load Zephyr board Kconfig descriptions.
osource "/home/anders/ncs/v3.1.1/zephyr/boards/96boards/nitrogen/Kconfig"
```

## build/WWD-n/Kconfig/boards/Kconfig.defconfig
```kconfig
# Load Zephyr board defconfig descriptions.
osource "/home/anders/ncs/v3.1.1/zephyr/boards/96boards/nitrogen/Kconfig.defconfig"
```
